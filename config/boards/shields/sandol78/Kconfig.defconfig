## config/boards/shields/sandol78/Kconfig.defconfig
```kconfig
if SHIELD_SANDOL78

config ZMK_KEYBOARD_NAME
    default "SandoL78"

config EC11
    default y

config PWM
    default y

config SPI
    default y

endif
```
